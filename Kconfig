## Kconfig
```kconfig
#
# Copyright (c) 2023 Nordic Semiconductor ASA
#
# SPDX-License-Identifier: LicenseRef-Nordic-5-Clause
#

menu "MQTT sample"

config MQTT_SAMPLE_PAYLOAD_CHANNEL_STRING_MAX_SIZE
	int "Payload maximum string size"
	default 100
	help
	  Maximum size of the string included messages that are sent over the payload channel.

config HTTP_CLIENT_EXAMPLE
	bool "Enable HTTP client example"
	default n

config HTTP_GET_EXAMPLE
	bool "Enable HTTP client example"
	default n

config HTTP_SERVER_EXAMPLE
	bool "Enable HTTP server example"
	default n

config DUMB_HTTP_SERVER_EXAMPLE
	bool "Enable dumb HTTP server example"
	default n


rsource "src/modules/trigger/Kconfig.trigger"
rsource "src/modules/sampler/Kconfig.sampler"
rsource "src/modules/network/Kconfig.network"
rsource "src/modules/transport/Kconfig.transport"
rsource "src/modules/error/Kconfig.error"
rsource "src/modules/led/Kconfig.led"

endmenu

menu "Zephyr Kernel"
source "Kconfig.zephyr"
endmenu
```
